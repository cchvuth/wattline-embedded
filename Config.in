## os/package/dash-ota/Config.in
```kconfig
config BR2_PACKAGE_DASH_OTA
	bool "dash-ota"
	select BR2_PACKAGE_OPENSSL
	select BR2_PACKAGE_LIBCURL
	select BR2_PACKAGE_LIBCURL_CURL
	select BR2_PACKAGE_CA_CERTIFICATES
	help
	  Over-the-air updates for the Dash: sig-verify (Ed25519 over the release's SHA256SUMS, with libcrypto);
	  dash-update and the boot script (dash.scr) come from the board overlay / post-image. Pulls in curl and the
	  CA bundle: busybox wget has no HTTPS.
```

## os/package/rtl8733bs/Config.in
```kconfig
config BR2_PACKAGE_RTL8733BS
	bool "rtl8733bs"
	depends on BR2_LINUX_KERNEL
	help
	  Realtek RTL8733BS SDIO WiFi vendor driver (8733bs.ko), station only, built against the image kernel.
	  The source is private and not in this tree: it is read from /radio/src/work (a Docker mount).
```

## os/package/spike-vdec/Config.in
```kconfig
config BR2_PACKAGE_SPIKE_VDEC
	bool "spike-vdec"
	help
	  R4 spike only: /usr/sbin/spike-vdec, H.264 decode on the video engine through the V4L2 stateless (request)
	  API (cedrus) with fps, CPU use and a bit-exact check, plus a CPU rotate estimate for the projection.
	  Plain C (the toolchain has no C++, so GStreamer's v4l2codecs and v4l-utils are out). The test clips are
	  made at build time (br-r4.sh) and copied in by post-build-r4.sh.
```

## os/package/wattline-aa/Config.in
```kconfig
config BR2_PACKAGE_WATTLINE_AA
	bool "wattline-aa"
	select BR2_PACKAGE_OPENSSL
	help
	  Wattline wireless Android Auto receiver (native C: OpenSSL + the dash
	  protobuf). Built from the app checkout (aa/aa.c + core/pb.c).
	  Installs /usr/bin/aa. The head-unit certificate is user-supplied on the
	  card, never shipped.
```

## package/bt-fwcutter/Config.in
```kconfig
config BR2_PACKAGE_BT_FWCUTTER
	bool "bt-fwcutter"
	help
	  Cuts a Realtek Bluetooth firmware patch and its UART config out of a binary that embeds them (the device's
	  own original Bluetooth daemon), so no firmware has to ship in the image. /usr/sbin/bt-fwcutter.
```

## package/dashapp/Config.in
```kconfig
config BR2_PACKAGE_DASHAPP
	bool "dashapp"
	depends on BR2_PACKAGE_BLUEZ5_UTILS # bluetoothd on D-Bus; brings libglib2 (gio) for the Commander session
	select BR2_PACKAGE_LIBGLIB2
	help
	  The dash program (dash-native app/, LVGL UI, CMDR=1: the Commander's Bluetooth session), installed as /usr/bin/dash.
	  The source is not in this tree: it is read from /native (a Docker mount of the dash-native checkout).
```

## package/rtl8733bs-cc/Config.in
```kconfig
config BR2_PACKAGE_RTL8733BS_CC
	bool "rtl8733bs-cc"
	depends on BR2_LINUX_KERNEL
	help
	  R4 spike only: the RTL8733BS driver a second time, as 8733bs_cc.ko in /lib/modules/<krel>/extra, with
	  concurrent mode (wlan0 station, wlan1 access point, one channel) and the AP ops on. Never loaded at
	  boot (spike-wifi-cc swaps it in, with an automatic rollback). BT coexistence on (no MCC: the driver
	  allows only one of the two, and without coex an AP starves classic Bluetooth).
	  Same private source as rtl8733bs (/radio/src/work); 8733bs-cc-ap-mcc.patch is applied to the build copy only.
```
