## Config.in
```kconfig
source "$BR2_EXTERNAL_DASH_PATH/package/rtl8733bs/Config.in"
source "$BR2_EXTERNAL_DASH_PATH/package/dashapp/Config.in"
source "$BR2_EXTERNAL_DASH_PATH/package/bt-fwcutter/Config.in"
```

## configs/dash_r2_defconfig
```kconfig
# R2 = R1 + the RTL8733BS radio: WiFi station (SDIO, 8733bs module, EU/ETSI channel plan) and BT (H5 on UART3, serdev). eMMC stays read-only.
# Needs the private radio tree mounted at /radio (docker -v ~/dash-ownfw/radio:/radio:ro): driver source /radio/src/work, BT firmware overlay /radio/overlay.
BR2_arm=y
BR2_cortex_a7=y
BR2_ARM_FPU_NEON_VFPV4=y
BR2_TOOLCHAIN_BUILDROOT_GLIBC=y
BR2_PACKAGE_HOST_LINUX_HEADERS_CUSTOM_6_18=y
# the toolchain and glibc were built on 6.18.8 headers (R0): keep them, the kernel moves to 7.3.4 alone
BR2_KERNEL_HEADERS_VERSION=y
BR2_DEFAULT_KERNEL_VERSION="6.18.8"
BR2_GLOBAL_PATCH_DIR="board/mangopi/mq1rdw2/patches $(BR2_EXTERNAL_DASH_PATH)/board/dash/patches"
BR2_DOWNLOAD_FORCE_CHECK_HASHES=y
BR2_TARGET_GENERIC_HOSTNAME="dash-r2"
BR2_TARGET_GENERIC_ISSUE="S3XY Dash R2 (eMMC read-only)"
BR2_ROOTFS_DEVICE_CREATION_DYNAMIC_DEVTMPFS=y
BR2_TARGET_GENERIC_GETTY_PORT="ttyS0"
BR2_TARGET_GENERIC_GETTY_BAUDRATE_115200=y
BR2_SYSTEM_DHCP=""
BR2_ROOTFS_OVERLAY="$(BR2_EXTERNAL_DASH_PATH)/board/dash/rootfs_overlay $(BR2_EXTERNAL_DASH_PATH)/board/dash/rootfs_overlay_r2 /radio/overlay"
BR2_ROOTFS_POST_IMAGE_SCRIPT="$(BR2_EXTERNAL_DASH_PATH)/board/dash/post-image-r2.sh"
BR2_LINUX_KERNEL=y
BR2_LINUX_KERNEL_CUSTOM_VERSION=y
BR2_LINUX_KERNEL_CUSTOM_VERSION_VALUE="7.3.4"
BR2_LINUX_KERNEL_DEFCONFIG="sunxi"
BR2_LINUX_KERNEL_CONFIG_FRAGMENT_FILES="$(BR2_EXTERNAL_DASH_PATH)/board/dash/linux-r0.fragment $(BR2_EXTERNAL_DASH_PATH)/board/dash/linux-r1.fragment $(BR2_EXTERNAL_DASH_PATH)/board/dash/linux-r2.fragment"
BR2_LINUX_KERNEL_DTS_SUPPORT=y
BR2_LINUX_KERNEL_INTREE_DTS_NAME="allwinner/sun8i-t113s-dash-r2"
BR2_LINUX_KERNEL_NEEDS_HOST_OPENSSL=y
BR2_PACKAGE_BUSYBOX_CONFIG_FRAGMENT_FILES="$(BR2_EXTERNAL_DASH_PATH)/board/dash/busybox.fragment"
BR2_PACKAGE_DOSFSTOOLS=y
BR2_PACKAGE_DOSFSTOOLS_FATLABEL=y
BR2_PACKAGE_DOSFSTOOLS_FSCK_FAT=y
BR2_PACKAGE_DOSFSTOOLS_MKFS_FAT=y
BR2_PACKAGE_E2FSPROGS=y
BR2_PACKAGE_MMC_UTILS=y
BR2_PACKAGE_UTIL_LINUX=y
BR2_PACKAGE_UTIL_LINUX_BINARIES=y
BR2_TARGET_ROOTFS_CPIO=y
BR2_TARGET_ROOTFS_CPIO_GZIP=y
BR2_TARGET_ROOTFS_CPIO_UIMAGE=y
# BR2_TARGET_ROOTFS_TAR is not set
BR2_TARGET_UBOOT=y
BR2_TARGET_UBOOT_BUILD_SYSTEM_KCONFIG=y
BR2_TARGET_UBOOT_CUSTOM_VERSION=y
BR2_TARGET_UBOOT_CUSTOM_VERSION_VALUE="2026.01"
BR2_TARGET_UBOOT_BOARD_DEFCONFIG="mangopi_mq_r"
BR2_TARGET_UBOOT_CONFIG_FRAGMENT_FILES="$(BR2_EXTERNAL_DASH_PATH)/board/dash/uboot-r0.fragment"
BR2_TARGET_UBOOT_CUSTOM_MAKEOPTS="KCFLAGS=-DDASH_U4=$(DASH_U4)"
BR2_TARGET_UBOOT_NEEDS_DTC=y
BR2_TARGET_UBOOT_NEEDS_PYLIBFDT=y
BR2_TARGET_UBOOT_NEEDS_OPENSSL=y
BR2_TARGET_UBOOT_NEEDS_GNUTLS=y
BR2_TARGET_UBOOT_SPL=y
BR2_TARGET_UBOOT_SPL_NAME="u-boot-sunxi-with-spl.bin"
BR2_PACKAGE_HOST_DOSFSTOOLS=y
BR2_PACKAGE_HOST_GENIMAGE=y
BR2_PACKAGE_HOST_MTOOLS=y
BR2_PACKAGE_HOST_UBOOT_TOOLS=y
BR2_PACKAGE_HOST_UBOOT_TOOLS_BOOT_SCRIPT=y
BR2_PACKAGE_HOST_UBOOT_TOOLS_BOOT_SCRIPT_SOURCE="$(BR2_EXTERNAL_DASH_PATH)/board/dash/boot-fel.cmd"
BR2_PACKAGE_LIBDRM=y
BR2_PACKAGE_LIBDRM_INSTALL_TESTS=y
BR2_PACKAGE_EVTEST=y
BR2_PACKAGE_LIBGPIOD=y
BR2_PACKAGE_LIBGPIOD_TOOLS=y
BR2_PACKAGE_RTL8733BS=y
BR2_PACKAGE_WIRELESS_REGDB=y
BR2_PACKAGE_IW=y
BR2_PACKAGE_WPA_SUPPLICANT=y
BR2_PACKAGE_WPA_SUPPLICANT_NL80211=y
BR2_PACKAGE_WPA_SUPPLICANT_WPA3=y
BR2_PACKAGE_WPA_SUPPLICANT_CLI=y
BR2_PACKAGE_BLUEZ5_UTILS=y
BR2_PACKAGE_BLUEZ5_UTILS_CLIENT=y
BR2_PACKAGE_BLUEZ5_UTILS_MONITOR=y
```

## os-f133/Config.in
```kconfig
source "$BR2_EXTERNAL_F133_PATH/package/aic8800/Config.in"
source "$BR2_EXTERNAL_F133_PATH/package/dash-ota/Config.in"
source "$BR2_EXTERNAL_F133_PATH/package/g2drot/Config.in"
source "$BR2_EXTERNAL_F133_PATH/package/mcud/Config.in"
source "$BR2_EXTERNAL_F133_PATH/package/dashapp/Config.in"
source "$BR2_EXTERNAL_F133_PATH/package/wattline-aa/Config.in"
source "$BR2_EXTERNAL_F133_PATH/package/spike-vdec/Config.in"
```

## os-f133/board/f133/kernel.its
```
/*
 * The NOR's "kernel" partition: the kernel, gzipped, and its device tree, a crc32 each; U-Boot's bootm checks them,
 * unpacks the kernel to its run address and boots it with that device tree. post-image.sh makes it (gzip -9, then
 * U-Boot's mkimage -f kernel.its kernel.itb) and checks that it fits the partition (0x440000).
 * gzip, not LZMA: 0.7 MB more to read, but the one core unpacks it in 0.8 s where LZMA took 2.3 (over half of the
 * 4.3 s from power-on to the kernel's start); crc32, not sha256 (0.35 s): it is there for a bad read, not an attacker.
 */
/dts-v1/;

/ {
	description = "SRNUBI T313D: Linux and its device tree";
	#address-cells = <1>;

	images {
		kernel {
			description = "Linux";
			data = /incbin/("Image.gz");
			type = "kernel";
			arch = "riscv";
			os = "linux";
			compression = "gzip";
			load = <0x40200000>;
			entry = <0x40200000>;
			hash {
				algo = "crc32";
			};
		};

		fdt {
			description = "sun20i-d1s-srnubi-t313d";
			data = /incbin/("f133.dtb");
			type = "flat_dt";
			arch = "riscv";
			compression = "none";
			hash {
				algo = "crc32";
			};
		};
	};

	configurations {
		default = "conf";

		conf {
			description = "SRNUBI T313D";
			kernel = "kernel";
			fdt = "fdt";
		};
	};
};
```

## os-f133/package/aic8800/Config.in
```kconfig
config BR2_PACKAGE_AIC8800
	bool "aic8800"
	depends on BR2_LINUX_KERNEL
	help
	  AICSemi AIC8800 Wi-Fi driver (SDIO) and firmware, from Radxa's
	  packaging of the vendor driver.

	  https://github.com/radxa-pkg/aic8800
```

## os-f133/package/dash-ota/Config.in
```kconfig
config BR2_PACKAGE_DASH_OTA
	bool "dash-ota"
	select BR2_PACKAGE_OPENSSL
	select BR2_PACKAGE_LIBCURL
	select BR2_PACKAGE_LIBCURL_CURL
	select BR2_PACKAGE_CA_CERTIFICATES
	help
	  Over-the-air updates (the T113 Dash's package): sig-verify (Ed25519 over the release's SHA256SUMS, with
	  libcrypto); dash-update and S99ota come from the board overlay. Pulls in curl and the CA bundle: busybox
	  wget has no HTTPS with certificate checks.
```

## os-f133/package/dashapp/Config.in
```kconfig
config BR2_PACKAGE_DASHAPP
	bool "dashapp"
	select BR2_PACKAGE_LIBGLIB2
	help
	  The dash program for this screen: the app checkout (mounted at /native) built with its F133 profile
	  (app/device/f133.mk) and the Commander's Bluetooth link. Installs /usr/lib/dash/dash and, beside it, the
	  Bluetooth session it loads once D-Bus is up (libdashble.so); S05dash runs it.
```

## os-f133/package/g2drot/Config.in
```kconfig
config BR2_PACKAGE_G2DROT
	bool "g2drot"
	depends on BR2_LINUX_KERNEL
	help
	  /dev/g2drot: the F133's G2D rotation unit for the dash's flush
	  (the landscape canvas turned into the portrait framebuffer by the
	  2D engine: 68 -> 25 ms a scrolled frame).
```

## os-f133/package/mcud/Config.in
```kconfig
config BR2_PACKAGE_MCUD
	bool "mcud"
	help
	  The SRNUBI T313D's power MCU on ttyS1: holds the screen's power (the MCU cuts it otherwise), sends the release
	  for a power cycle, and relays the MCU's classic Bluetooth (AT# lines and its RFCOMM data channels) over
	  /run/mcud.sock. S03mcu starts it.
```

## os-f133/package/spike-vdec/Config.in
```kconfig
config BR2_PACKAGE_SPIKE_VDEC
	bool "spike-vdec"
	help
	  The H.264 decoder sink of the projection (Linux's cedrus stateless decoder), built from the app checkout
	  (/native/vdec): it draws the phone's picture into the dash's region of the portrait framebuffer.
```

## os-f133/package/wattline-aa/Config.in
```kconfig
config BR2_PACKAGE_WATTLINE_AA
	bool "wattline-aa"
	select BR2_PACKAGE_OPENSSL
	help
	  The wireless Android Auto receiver (aa), built from the app checkout (/native: aa/aa.c, core/pb.c) for this
	  screen: the Bluetooth start through its power MCU (aa mcu, mcud), only the system audio
	  sink offered. dash-aa runs it.
```

## os/Config.in
```kconfig
source "$BR2_EXTERNAL_DASH_PATH/package/rtl8733bs/Config.in"
source "$BR2_EXTERNAL_DASH_PATH/package/dashapp/Config.in"
source "$BR2_EXTERNAL_DASH_PATH/package/bt-fwcutter/Config.in"
source "$BR2_EXTERNAL_DASH_PATH/package/rtl8733bs-cc/Config.in"
source "$BR2_EXTERNAL_DASH_PATH/package/spike-vdec/Config.in"
source "$BR2_EXTERNAL_DASH_PATH/package/wattline-aa/Config.in"
source "$BR2_EXTERNAL_DASH_PATH/package/dash-ota/Config.in"
```

## os/configs/dash_r1_defconfig
```kconfig
# R1 = R0 + display (MIPI-DSI panel), touch, USB gadget ethernet; Linux 7.3.4 (T113 DSI needs 7.3+). eMMC stays read-only, no radio.
BR2_arm=y
BR2_cortex_a7=y
BR2_ARM_FPU_NEON_VFPV4=y
BR2_TOOLCHAIN_BUILDROOT_GLIBC=y
BR2_PACKAGE_HOST_LINUX_HEADERS_CUSTOM_6_18=y
# the toolchain and glibc were built on 6.18.8 headers (R0): keep them, the kernel moves to 7.3.4 alone
BR2_KERNEL_HEADERS_VERSION=y
BR2_DEFAULT_KERNEL_VERSION="6.18.8"
BR2_GLOBAL_PATCH_DIR="board/mangopi/mq1rdw2/patches $(BR2_EXTERNAL_DASH_PATH)/board/dash/patches"
BR2_DOWNLOAD_FORCE_CHECK_HASHES=y
BR2_TARGET_GENERIC_HOSTNAME="dash-r1"
BR2_TARGET_GENERIC_ISSUE="S3XY Dash R1 (eMMC read-only)"
BR2_ROOTFS_DEVICE_CREATION_DYNAMIC_DEVTMPFS=y
BR2_TARGET_GENERIC_GETTY_PORT="ttyS0"
BR2_TARGET_GENERIC_GETTY_BAUDRATE_115200=y
BR2_SYSTEM_DHCP=""
BR2_ROOTFS_OVERLAY="$(BR2_EXTERNAL_DASH_PATH)/board/dash/rootfs_overlay"
BR2_ROOTFS_POST_IMAGE_SCRIPT="$(BR2_EXTERNAL_DASH_PATH)/board/dash/post-image-r1.sh"
BR2_LINUX_KERNEL=y
BR2_LINUX_KERNEL_CUSTOM_VERSION=y
BR2_LINUX_KERNEL_CUSTOM_VERSION_VALUE="7.3.4"
BR2_LINUX_KERNEL_DEFCONFIG="sunxi"
BR2_LINUX_KERNEL_CONFIG_FRAGMENT_FILES="$(BR2_EXTERNAL_DASH_PATH)/board/dash/linux-r0.fragment $(BR2_EXTERNAL_DASH_PATH)/board/dash/linux-r1.fragment"
BR2_LINUX_KERNEL_DTS_SUPPORT=y
BR2_LINUX_KERNEL_INTREE_DTS_NAME="allwinner/sun8i-t113s-dash-r1"
BR2_LINUX_KERNEL_NEEDS_HOST_OPENSSL=y
BR2_PACKAGE_BUSYBOX_CONFIG_FRAGMENT_FILES="$(BR2_EXTERNAL_DASH_PATH)/board/dash/busybox.fragment"
BR2_PACKAGE_DOSFSTOOLS=y
BR2_PACKAGE_DOSFSTOOLS_FATLABEL=y
BR2_PACKAGE_DOSFSTOOLS_FSCK_FAT=y
BR2_PACKAGE_DOSFSTOOLS_MKFS_FAT=y
BR2_PACKAGE_E2FSPROGS=y
BR2_PACKAGE_MMC_UTILS=y
BR2_PACKAGE_UTIL_LINUX=y
BR2_PACKAGE_UTIL_LINUX_BINARIES=y
BR2_TARGET_ROOTFS_CPIO=y
BR2_TARGET_ROOTFS_CPIO_GZIP=y
BR2_TARGET_ROOTFS_CPIO_UIMAGE=y
# BR2_TARGET_ROOTFS_TAR is not set
BR2_TARGET_UBOOT=y
BR2_TARGET_UBOOT_BUILD_SYSTEM_KCONFIG=y
BR2_TARGET_UBOOT_CUSTOM_VERSION=y
BR2_TARGET_UBOOT_CUSTOM_VERSION_VALUE="2026.01"
BR2_TARGET_UBOOT_BOARD_DEFCONFIG="mangopi_mq_r"
BR2_TARGET_UBOOT_CONFIG_FRAGMENT_FILES="$(BR2_EXTERNAL_DASH_PATH)/board/dash/uboot-r0.fragment"
BR2_TARGET_UBOOT_CUSTOM_MAKEOPTS="KCFLAGS=-DDASH_U4=$(DASH_U4)"
BR2_TARGET_UBOOT_NEEDS_DTC=y
BR2_TARGET_UBOOT_NEEDS_PYLIBFDT=y
BR2_TARGET_UBOOT_NEEDS_OPENSSL=y
BR2_TARGET_UBOOT_NEEDS_GNUTLS=y
BR2_TARGET_UBOOT_SPL=y
BR2_TARGET_UBOOT_SPL_NAME="u-boot-sunxi-with-spl.bin"
BR2_PACKAGE_HOST_DOSFSTOOLS=y
BR2_PACKAGE_HOST_GENIMAGE=y
BR2_PACKAGE_HOST_MTOOLS=y
BR2_PACKAGE_HOST_UBOOT_TOOLS=y
BR2_PACKAGE_HOST_UBOOT_TOOLS_BOOT_SCRIPT=y
BR2_PACKAGE_HOST_UBOOT_TOOLS_BOOT_SCRIPT_SOURCE="$(BR2_EXTERNAL_DASH_PATH)/board/dash/boot-fel.cmd"
BR2_PACKAGE_LIBDRM=y
BR2_PACKAGE_LIBDRM_INSTALL_TESTS=y
BR2_PACKAGE_EVTEST=y
BR2_PACKAGE_LIBGPIOD=y
BR2_PACKAGE_LIBGPIOD_TOOLS=y
```

## os/configs/dash_r4_defconfig
```kconfig
# R4 = R3 + the Phase 0 projection spike (hardware tests only, never a product): I2C1/I2C2 enabled for a read-only
# auth-chip scan, the PCF8563 RTC (+ hwclock at boot), the video engine node (cedrus) with a C test decoder and rotate
# estimate, a second WiFi module 8733bs_cc (concurrent mode + MCC, AP) never loaded at boot, hostapd/udhcpd/iperf3 for
# its test access point. Built in /work/out-r4 (br-r4.sh). R3's DT, overlay and module stay as they are.
# Needs /radio and /native as R3 does.
BR2_arm=y
BR2_cortex_a7=y
BR2_ARM_FPU_NEON_VFPV4=y
BR2_TOOLCHAIN_BUILDROOT_GLIBC=y
BR2_PACKAGE_HOST_LINUX_HEADERS_CUSTOM_6_18=y
# the toolchain and glibc were built on 6.18.8 headers (R0): keep them, the kernel moves to 7.3.4 alone
BR2_KERNEL_HEADERS_VERSION=y
BR2_DEFAULT_KERNEL_VERSION="6.18.8"
BR2_GLOBAL_PATCH_DIR="board/mangopi/mq1rdw2/patches $(BR2_EXTERNAL_DASH_PATH)/board/dash/patches $(BR2_EXTERNAL_DASH_PATH)/board/dash/patches-r4"
BR2_DOWNLOAD_FORCE_CHECK_HASHES=y
BR2_TARGET_GENERIC_HOSTNAME="dash"
BR2_TARGET_GENERIC_ISSUE="S3XY Dash R4 spike (eMMC read-only)"
BR2_ROOTFS_DEVICE_CREATION_DYNAMIC_DEVTMPFS=y
BR2_TARGET_GENERIC_GETTY_PORT="ttyS0"
BR2_TARGET_GENERIC_GETTY_BAUDRATE_115200=y
BR2_SYSTEM_DHCP=""
BR2_ROOTFS_OVERLAY="$(BR2_EXTERNAL_DASH_PATH)/board/dash/rootfs_overlay $(BR2_EXTERNAL_DASH_PATH)/board/dash/rootfs_overlay_r2 $(BR2_EXTERNAL_DASH_PATH)/board/dash/rootfs_overlay_r3 $(BR2_EXTERNAL_DASH_PATH)/board/dash/rootfs_overlay_r4"
BR2_ROOTFS_POST_BUILD_SCRIPT="$(BR2_EXTERNAL_DASH_PATH)/board/dash/post-build-r3.sh $(BR2_EXTERNAL_DASH_PATH)/board/dash/post-build-r4.sh"
BR2_ROOTFS_POST_IMAGE_SCRIPT="$(BR2_EXTERNAL_DASH_PATH)/board/dash/post-image-r4.sh"
BR2_LINUX_KERNEL=y
BR2_LINUX_KERNEL_CUSTOM_VERSION=y
BR2_LINUX_KERNEL_CUSTOM_VERSION_VALUE="7.3.4"
BR2_LINUX_KERNEL_DEFCONFIG="sunxi"
BR2_LINUX_KERNEL_CONFIG_FRAGMENT_FILES="$(BR2_EXTERNAL_DASH_PATH)/board/dash/linux-r0.fragment $(BR2_EXTERNAL_DASH_PATH)/board/dash/linux-r1.fragment $(BR2_EXTERNAL_DASH_PATH)/board/dash/linux-r2.fragment $(BR2_EXTERNAL_DASH_PATH)/board/dash/linux-r4.fragment"
BR2_LINUX_KERNEL_DTS_SUPPORT=y
BR2_LINUX_KERNEL_INTREE_DTS_NAME="allwinner/sun8i-t113s-dash-r4"
BR2_LINUX_KERNEL_NEEDS_HOST_OPENSSL=y
BR2_PACKAGE_BUSYBOX_CONFIG_FRAGMENT_FILES="$(BR2_EXTERNAL_DASH_PATH)/board/dash/busybox.fragment $(BR2_EXTERNAL_DASH_PATH)/board/dash/busybox-r4.fragment"
BR2_PACKAGE_DOSFSTOOLS=y
BR2_PACKAGE_DOSFSTOOLS_FATLABEL=y
BR2_PACKAGE_DOSFSTOOLS_FSCK_FAT=y
BR2_PACKAGE_DOSFSTOOLS_MKFS_FAT=y
BR2_PACKAGE_E2FSPROGS=y
BR2_PACKAGE_MMC_UTILS=y
BR2_PACKAGE_UTIL_LINUX=y
BR2_PACKAGE_UTIL_LINUX_BINARIES=y
BR2_TARGET_ROOTFS_CPIO=y
BR2_TARGET_ROOTFS_CPIO_GZIP=y
BR2_TARGET_ROOTFS_CPIO_UIMAGE=y
# BR2_TARGET_ROOTFS_TAR is not set
BR2_TARGET_UBOOT=y
BR2_TARGET_UBOOT_BUILD_SYSTEM_KCONFIG=y
BR2_TARGET_UBOOT_CUSTOM_VERSION=y
BR2_TARGET_UBOOT_CUSTOM_VERSION_VALUE="2026.01"
BR2_TARGET_UBOOT_BOARD_DEFCONFIG="mangopi_mq_r"
BR2_TARGET_UBOOT_CONFIG_FRAGMENT_FILES="$(BR2_EXTERNAL_DASH_PATH)/board/dash/uboot-r0.fragment"
BR2_TARGET_UBOOT_CUSTOM_MAKEOPTS="KCFLAGS=-DDASH_U4=$(DASH_U4)"
BR2_TARGET_UBOOT_NEEDS_DTC=y
BR2_TARGET_UBOOT_NEEDS_PYLIBFDT=y
BR2_TARGET_UBOOT_NEEDS_OPENSSL=y
BR2_TARGET_UBOOT_NEEDS_GNUTLS=y
BR2_TARGET_UBOOT_SPL=y
BR2_TARGET_UBOOT_SPL_NAME="u-boot-sunxi-with-spl.bin"
BR2_PACKAGE_HOST_DOSFSTOOLS=y
BR2_PACKAGE_HOST_GENIMAGE=y
BR2_PACKAGE_HOST_MTOOLS=y
BR2_PACKAGE_HOST_UBOOT_TOOLS=y
BR2_PACKAGE_HOST_UBOOT_TOOLS_BOOT_SCRIPT=y
BR2_PACKAGE_HOST_UBOOT_TOOLS_BOOT_SCRIPT_SOURCE="$(BR2_EXTERNAL_DASH_PATH)/board/dash/boot-fel.cmd"
BR2_PACKAGE_LIBDRM=y
BR2_PACKAGE_LIBDRM_INSTALL_TESTS=y
BR2_PACKAGE_EVTEST=y
BR2_PACKAGE_LIBGPIOD=y
BR2_PACKAGE_LIBGPIOD_TOOLS=y
BR2_PACKAGE_RTL8733BS=y
BR2_PACKAGE_WIRELESS_REGDB=y
BR2_PACKAGE_IW=y
BR2_PACKAGE_WPA_SUPPLICANT=y
BR2_PACKAGE_WPA_SUPPLICANT_NL80211=y
BR2_PACKAGE_WPA_SUPPLICANT_WPA3=y
BR2_PACKAGE_WPA_SUPPLICANT_CLI=y
BR2_PACKAGE_BLUEZ5_UTILS=y
BR2_PACKAGE_BLUEZ5_UTILS_CLIENT=y
BR2_PACKAGE_BLUEZ5_UTILS_MONITOR=y
BR2_PACKAGE_DROPBEAR=y
BR2_PACKAGE_DASHAPP=y
BR2_PACKAGE_BT_FWCUTTER=y
# R4 spike
BR2_PACKAGE_RTL8733BS_CC=y
BR2_PACKAGE_SPIKE_VDEC=y
BR2_PACKAGE_HOSTAPD=y
# BR2_PACKAGE_HOSTAPD_DRIVER_HOSTAP is not set
# BR2_PACKAGE_HOSTAPD_ACS is not set
# BR2_PACKAGE_HOSTAPD_VLAN is not set
BR2_PACKAGE_IPERF3=y
BR2_PACKAGE_OPENSSL=y
BR2_PACKAGE_WATTLINE_AA=y
BR2_PACKAGE_LIBCURL=y
BR2_PACKAGE_LIBCURL_CURL=y
BR2_PACKAGE_CA_CERTIFICATES=y
BR2_PACKAGE_DASH_OTA=y
```
